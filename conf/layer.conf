## conf/layer.conf
```bitbake
# We have a conf and classes directory, add to BBPATH
BBPATH .= ":${LAYERDIR}"

# We have recipes-* directories, add to BBFILES
BBFILES += "${LAYERDIR}/recipes-*/*/*.bb \
            ${LAYERDIR}/recipes-*/*/*.bbappend"

BBFILE_COLLECTIONS += "meta-aristaos"
BBFILE_PATTERN_meta-aristaos = "^${LAYERDIR}/"
BBFILE_PRIORITY_meta-aristaos = "6"

LAYERDEPENDS_meta-aristaos = "core"
LAYERSERIES_COMPAT_meta-aristaos = "warrior zeus"
```
